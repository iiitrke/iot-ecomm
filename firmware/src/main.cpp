// IoTEcomm - ESP32 button ordering device
//
//  * Each product button cycles its quantity 0 -> 1 -> 2 -> 3 -> 4 -> 5 -> 0; the 5 LEDs in its row show it.
//  * Holding a product button (LONG_PRESS_MS) clears that product.
//  * SUBMIT sends the cart to the backend over HTTPS (CA-pinned). The backend publishes it to Kafka over SSL.
//      success            -> SUCCESS LED solid for 3 s, cart cleared
//      network/server err -> SUCCESS LED blinks 3x slowly, cart kept (press SUBMIT again to retry, same order id)
//      rejected (4xx)     -> SUCCESS LED blinks 8x fast, cart kept
//      empty cart         -> SUCCESS LED blinks 2x fast
//  * PENDING LED is on while this device has at least one open (not delivered/cancelled) order.
//  * On-board LED: solid = WiFi connected, blinking = connecting.

#include <Arduino.h>
#include <WiFi.h>
#include <WiFiClientSecure.h>
#include <HTTPClient.h>
#include <ArduinoJson.h>
#include <time.h>

#include "config.h"
#include "secrets.h"
#include "ca_cert.h"   // generated by scripts/gen-certs.sh

static_assert(sizeof(PRODUCT_SKUS) / sizeof(PRODUCT_SKUS[0]) == sizeof(PRODUCT_BUTTON_PINS),
              "PRODUCT_SKUS and PRODUCT_BUTTON_PINS must have the same length");

static const uint8_t TOTAL_QTY_LEDS = NUM_PRODUCTS * LEDS_PER_PRODUCT;
static const uint8_t NUM_SHIFT_REGS = (TOTAL_QTY_LEDS + 7) / 8;

// ---------------------------------------------------------------------------
// Debounced button
// ---------------------------------------------------------------------------
enum class ButtonEvent { None, ShortPress, LongPress };

struct Button {
  uint8_t pin;
  bool stablePressed = false;
  bool lastRawPressed = false;
  uint32_t lastChangeMs = 0;
  uint32_t pressedAtMs = 0;
  bool longFired = false;

  void begin(uint8_t p) {
    pin = p;
    pinMode(pin, INPUT_PULLUP);
  }

  ButtonEvent update(uint32_t now) {
    bool raw = digitalRead(pin) == LOW;  // active low
    if (raw != lastRawPressed) {
      lastRawPressed = raw;
      lastChangeMs = now;
    }
    if (now - lastChangeMs < DEBOUNCE_MS) {
      // Still bouncing; only check for a long press on a held button.
    } else if (raw != stablePressed) {
      stablePressed = raw;
      if (stablePressed) {
        pressedAtMs = now;
        longFired = false;
      } else if (!longFired) {
        return ButtonEvent::ShortPress;  // fires on release so it can't also be a long press
      }
    }
    if (stablePressed && !longFired && now - pressedAtMs >= LONG_PRESS_MS) {
      longFired = true;
      return ButtonEvent::LongPress;
    }
    return ButtonEvent::None;
  }
};

// ---------------------------------------------------------------------------
// Non-blocking status LED (solid for a while, or blink N times)
// ---------------------------------------------------------------------------
struct StatusLed {
  uint8_t pin;
  uint32_t onUntil = 0;
  uint8_t blinksLeft = 0;  // counts half-periods remaining
  uint16_t halfPeriod = 0;
  uint32_t nextToggle = 0;
  bool level = false;

  void begin(uint8_t p) {
    pin = p;
    pinMode(pin, OUTPUT);
    digitalWrite(pin, LOW);
  }
  void solidFor(uint32_t ms) {
    blinksLeft = 0;
    onUntil = millis() + ms;
    set(true);
  }
  void blink(uint8_t times, uint16_t periodMs) {
    onUntil = 0;
    blinksLeft = times * 2;
    halfPeriod = periodMs / 2;
    nextToggle = millis();
  }
  void set(bool on) {
    level = on;
    digitalWrite(pin, on ? HIGH : LOW);
  }
  void update(uint32_t now) {
    if (blinksLeft > 0) {
      if ((int32_t)(now - nextToggle) >= 0) {
        set(!level);
        blinksLeft--;
        nextToggle = now + halfPeriod;
        if (blinksLeft == 0) set(false);
      }
    } else if (onUntil && (int32_t)(now - onUntil) >= 0) {
      onUntil = 0;
      set(false);
    }
  }
};

// ---------------------------------------------------------------------------
// State
// ---------------------------------------------------------------------------
Button productButtons[NUM_PRODUCTS];
Button submitButton;
StatusLed successLed;

uint8_t quantities[NUM_PRODUCTS] = {0};
String clientOrderId;          // reused on retry so the backend can de-duplicate
int32_t pendingCount = -1;     // -1 = unknown
uint32_t nextPendingPollMs = 0;
uint32_t lastWifiAttemptMs = 0;
bool timeSynced = false;

// ---------------------------------------------------------------------------
// Quantity LEDs via 74HC595 chain
// ---------------------------------------------------------------------------
void renderQuantityLeds() {
  uint8_t bytes[NUM_SHIFT_REGS] = {0};
  for (uint8_t p = 0; p < NUM_PRODUCTS; p++) {
    for (uint8_t s = 0; s < quantities[p] && s < LEDS_PER_PRODUCT; s++) {
      uint8_t n = p * LEDS_PER_PRODUCT + s;
      bytes[n / 8] |= (1 << (n % 8));
    }
  }
  digitalWrite(SR_LATCH_PIN, LOW);
  // The first byte shifted out ends up in the last chip of the chain.
  for (int i = NUM_SHIFT_REGS - 1; i >= 0; i--) {
    shiftOut(SR_DATA_PIN, SR_CLOCK_PIN, MSBFIRST, bytes[i]);
  }
  digitalWrite(SR_LATCH_PIN, HIGH);
}

void cartChanged() {
  clientOrderId = "";  // new cart contents -> new order
  renderQuantityLeds();
}

uint16_t cartTotalItems() {
  uint16_t total = 0;
  for (uint8_t p = 0; p < NUM_PRODUCTS; p++) total += quantities[p];
  return total;
}

// ---------------------------------------------------------------------------
// Networking
// ---------------------------------------------------------------------------
void ensureWifi(uint32_t now) {
  if (WiFi.status() == WL_CONNECTED) {
    digitalWrite(WIFI_LED_PIN, HIGH);
    if (!timeSynced) {
      // TLS certificate validity checks need a real clock.
      configTime(0, 0, "pool.ntp.org", "time.google.com");
      struct tm tmNow;
      if (getLocalTime(&tmNow, 5000) && tmNow.tm_year + 1900 >= 2024) {
        timeSynced = true;
        Serial.println("[time] synced");
        nextPendingPollMs = now;  // refresh pending LED right away
      }
    }
    return;
  }
  digitalWrite(WIFI_LED_PIN, (now / 300) % 2);  // blink while offline
  if (now - lastWifiAttemptMs >= WIFI_RETRY_MS || lastWifiAttemptMs == 0) {
    lastWifiAttemptMs = now;
    Serial.printf("[wifi] connecting to %s\n", WIFI_SSID);
    WiFi.disconnect();
    WiFi.begin(WIFI_SSID, WIFI_PASSWORD);
  }
}

bool online() { return WiFi.status() == WL_CONNECTED && timeSynced; }

// Performs an HTTPS request to the backend. Returns HTTP status (<=0 on transport error).
int backendRequest(const char* method, const char* path, const String& body, String& response) {
  WiFiClientSecure tls;
  tls.setCACert(ROOT_CA_PEM);
  tls.setTimeout(HTTP_TIMEOUT_MS / 1000);

  HTTPClient http;
  http.setTimeout(HTTP_TIMEOUT_MS);
  http.setConnectTimeout(HTTP_TIMEOUT_MS);
  if (!http.begin(tls, BACKEND_HOST, BACKEND_PORT, path, true)) return -1;
  http.addHeader("X-Device-Id", DEVICE_ID);
  http.addHeader("X-Api-Key", DEVICE_API_KEY);
  http.addHeader("Accept", "application/json");

  int code;
  if (strcmp(method, "POST") == 0) {
    http.addHeader("Content-Type", "application/json");
    code = http.POST(body);
  } else {
    code = http.GET();
  }
  if (code > 0) response = http.getString();
  else Serial.printf("[http] %s %s failed: %s\n", method, path, http.errorToString(code).c_str());
  http.end();
  return code;
}

String newClientOrderId() {
  char buf[40];
  snprintf(buf, sizeof(buf), "%lx-%08lx", (unsigned long)time(nullptr), (unsigned long)esp_random());
  return String(buf);
}

void submitOrder() {
  if (cartTotalItems() == 0) {
    successLed.blink(2, 200);
    return;
  }
  if (!online()) {
    Serial.println("[order] offline, cannot submit");
    successLed.blink(3, 600);
    return;
  }
  if (clientOrderId.isEmpty()) clientOrderId = newClientOrderId();

  JsonDocument doc;
  doc["clientOrderId"] = clientOrderId;
  JsonArray items = doc["items"].to<JsonArray>();
  for (uint8_t p = 0; p < NUM_PRODUCTS; p++) {
    if (quantities[p] == 0) continue;
    JsonObject it = items.add<JsonObject>();
    it["sku"] = PRODUCT_SKUS[p];
    it["quantity"] = quantities[p];
  }
  String body;
  serializeJson(doc, body);

  Serial.printf("[order] submitting %s: %s\n", clientOrderId.c_str(), body.c_str());
  digitalWrite(SUCCESS_LED_PIN, HIGH);  // brief "working" indication while the request blocks
  String resp;
  int code = backendRequest("POST", "/api/device/orders", body, resp);
  digitalWrite(SUCCESS_LED_PIN, LOW);
  Serial.printf("[order] HTTP %d %s\n", code, resp.c_str());

  if (code == 202 || code == 200 || code == 201) {
    successLed.solidFor(SUCCESS_LED_ON_MS);
    memset(quantities, 0, sizeof(quantities));
    cartChanged();
    nextPendingPollMs = millis() + POST_SUBMIT_POLL_MS;
  } else if (code >= 400 && code < 500) {
    successLed.blink(8, 150);   // rejected: check SKUs / device credentials
  } else {
    successLed.blink(3, 600);   // network / server problem: press SUBMIT again to retry
  }
}

void pollPending() {
  String resp;
  int code = backendRequest("GET", "/api/device/orders/pending", "", resp);
  if (code != 200) return;  // keep last known state
  JsonDocument doc;
  if (deserializeJson(doc, resp)) return;
  pendingCount = doc["pendingCount"] | 0;
  digitalWrite(PENDING_LED_PIN, pendingCount > 0 ? HIGH : LOW);
  Serial.printf("[pending] %d open order(s)\n", pendingCount);
}

// ---------------------------------------------------------------------------
// Arduino entry points
// ---------------------------------------------------------------------------
void setup() {
  Serial.begin(115200);
  Serial.printf("\nIoTEcomm device %s, %u products\n", DEVICE_ID, NUM_PRODUCTS);

  pinMode(SR_DATA_PIN, OUTPUT);
  pinMode(SR_CLOCK_PIN, OUTPUT);
  pinMode(SR_LATCH_PIN, OUTPUT);
  pinMode(PENDING_LED_PIN, OUTPUT);
  pinMode(WIFI_LED_PIN, OUTPUT);
  digitalWrite(PENDING_LED_PIN, LOW);
  successLed.begin(SUCCESS_LED_PIN);

  for (uint8_t p = 0; p < NUM_PRODUCTS; p++) productButtons[p].begin(PRODUCT_BUTTON_PINS[p]);
  submitButton.begin(SUBMIT_BUTTON_PIN);

  // Lamp test: light every quantity LED briefly.
  memset(quantities, LEDS_PER_PRODUCT, sizeof(quantities));
  renderQuantityLeds();
  delay(500);
  memset(quantities, 0, sizeof(quantities));
  renderQuantityLeds();

  WiFi.mode(WIFI_STA);
  WiFi.setAutoReconnect(true);
}

void loop() {
  uint32_t now = millis();
  ensureWifi(now);

  for (uint8_t p = 0; p < NUM_PRODUCTS; p++) {
    switch (productButtons[p].update(now)) {
      case ButtonEvent::ShortPress:
        quantities[p] = (quantities[p] + 1) % (LEDS_PER_PRODUCT + 1);
        Serial.printf("[cart] %s = %u\n", PRODUCT_SKUS[p], quantities[p]);
        cartChanged();
        break;
      case ButtonEvent::LongPress:
        quantities[p] = 0;
        Serial.printf("[cart] %s cleared\n", PRODUCT_SKUS[p]);
        cartChanged();
        break;
      default:
        break;
    }
  }

  if (submitButton.update(now) == ButtonEvent::ShortPress) submitOrder();

  if (online() && (int32_t)(millis() - nextPendingPollMs) >= 0) {
    pollPending();
    nextPendingPollMs = millis() + PENDING_POLL_MS;
  }

  successLed.update(millis());
  delay(2);
}
